## firmware/zmk-autoswitch/Kconfig
```kconfig
# AutoSwitch KVM host channel for ZMK (see README.md).

config ZMK_AUTOSWITCH
    bool "AutoSwitch KVM: let the computer change the Bluetooth profile"
    depends on RAW_HID
    depends on ZMK_BLE
    depends on SETTINGS
    help
      Lets the AutoSwitch KVM app on the connected computer read and select this keyboard's
      Bluetooth profile, so the keyboard follows a KVM switch. Needs the zmk-raw-hid module
      (add the raw_hid_adapter shield).

if ZMK_AUTOSWITCH

config ZMK_AUTOSWITCH_SELECT_DELAY_MS
    int "Delay between replying to SELECT and switching the profile (ms)"
    default 100
    help
      The reply has to leave before the connection to the current computer drops.

endif
```
